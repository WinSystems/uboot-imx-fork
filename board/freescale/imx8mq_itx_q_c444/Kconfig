## board/freescale/imx8mq_itx_q_c444/Kconfig
```kconfig
if TARGET_IMX8MQ_ITX_P_C444

config SYS_BOARD
	default "imx8mq_itx_p_c444"

config SYS_VENDOR
	default "winsystems"

config SYS_CONFIG_NAME
	default "imx8mq_itx_p_c444"

config IMX_CONFIG
	default "arch/arm/mach-imx/imx8m/imximage.cfg"

source "board/freescale/common/Kconfig"

endif
```
